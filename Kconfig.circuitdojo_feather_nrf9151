## Kconfig.circuitdojo_feather_nrf9151
```kconfig
# Copyright (c) 2020-2024 Circuit Dojo LLC
# Copyright (c) 2025 Embever GmbH
# SPDX-License-Identifier: Apache-2.0

config BOARD_EMBEVER_FEATHER_NRF9151
	select SOC_NRF9151_LACA
```

## Kconfig.defconfig
```kconfig
if BOARD_EMBEVER_FEATHER_NRF9151 || BOARD_EMBEVER_FEATHER_NRF9151_NS

config BOARD_EMBEVER_FEATHER_NRF9151
	select USE_DT_CODE_PARTITION if BOARD_EMBEVER_FEATHER_NRF9151_NS

endif # BOARD_EMBEVER_FEATHER_NRF9151 || BOARD_EMBEVER_FEATHER_NRF9151_NS
```

## board.yml
```yaml
board:
  name: embever_feather_nrf9151
  vendor: Embever
  socs:
  - name: nrf9151
    variants:
    - name: 'ns'
  revision:
    format: major.minor.patch
    default: "2.0.0"
    revisions:
    - name: "1.1.0"
    - name: "2.0.0"
```
