/dts-v1/;
#include <nordic/nrf9151ns_laca.dtsi>
#include "embever_feather_nrf9151_common.dtsi"



/ {
	chosen {
		zephyr,flash = &flash0;
		zephyr,sram = &sram0_ns;
		zephyr,code-partition = &slot0_ns_partition;
	};
};
